## wisp-firmware/os/meta-wisp/conf/layer.conf
```bitbake
BBPATH .= ":${LAYERDIR}"
BBFILES += "${LAYERDIR}/recipes-*/*/*.bb ${LAYERDIR}/recipes-*/*/*.bbappend"

BBFILE_COLLECTIONS += "wisp"
BBFILE_PATTERN_wisp := "^${LAYERDIR}/"
BBFILE_PRIORITY_wisp = "30"
LAYERVERSION_wisp = "1"
LAYERSERIES_COMPAT_wisp = "scarthgap wrynose"
LAYERDEPENDS_wisp = "core superbird meson chromium-browser-layer"
```
